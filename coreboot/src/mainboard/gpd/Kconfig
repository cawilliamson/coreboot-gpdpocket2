## coreboot/src/mainboard/gpd/Kconfig
```kconfig
if VENDOR_GPD

choice
	prompt "Mainboard model"

source "src/mainboard/gpd/*/Kconfig.name"

endchoice

source "src/mainboard/gpd/*/Kconfig"

config MAINBOARD_VENDOR
	string
	default "GPD"

endif # VENDOR_GPD
```

## coreboot/src/mainboard/gpd/pocket2/Kconfig
```kconfig
##
## This file is part of the coreboot project.
##
## Copyright (C) 2011-2012  Alexandru Gagniuc <mr.nuke.me@gmail.com>
##
## This program is free software: you can redistribute it and/or modify
## it under the terms of the GNU General Public License as published by
## the Free Software Foundation, either version 2 of the License, or
## (at your option) any later version.
##
## This program is distributed in the hope that it will be useful,
## but WITHOUT ANY WARRANTY; without even the implied warranty of
## MERCHANTABILITY or FITNESS FOR A PARTICULAR PURPOSE.  See the
## GNU General Public License for more details.
##

if BOARD_GPD_POCKET2

config BOARD_SPECIFIC_OPTIONS
	def_bool y
	select BOARD_ROMSIZE_KB_4096
	select PCI_DEVICE_ID_INTEL_KBL_ID_Y
	select PCI_DEVICE_ID_INTEL_SPT_LP_Y_PREMIUM_HDCP22
	select SOC_INTEL_KABYLAKE

config MAINBOARD_DIR
	string
	default gpd/pocket2

config MAINBOARD_PART_NUMBER
	string
	default "POCKET2"

config IRQ_SLOT_COUNT
	int
	default 13 # TODO: replace count with GPD Pocket 2 count

endif # BOARD_GPD_POCKET2
```
